#include "torabo_tsuki_lp.dtsi"
#include <input/processors.dtsi>
#include <dt-bindings/zmk/input_transform.h>

&pointing_listener {
    input-processors = <&zip_xy_transform (INPUT_TRANSFORM_X_INVERT | INPUT_TRANSFORM_Y_INVERT)>,
                       <&zip_xy_scaler 10 10>,
                       <&zip_temp_layer 5 700>;

    scroller {
        layers = <6>;
        process-next;
        // センサー反転(X|Y)とホイール標準方向(Y)の合成でXのみ反転
        input-processors = <&zip_xy_transform INPUT_TRANSFORM_X_INVERT>,
                           <&zip_xy_to_scroll_mapper>;
    };

    fast {
        layers = <7>;
        input-processors = <&zip_xy_transform (INPUT_TRANSFORM_X_INVERT | INPUT_TRANSFORM_Y_INVERT)>,
                           <&zip_xy_scaler 20 10>,
                           <&zip_temp_layer 5 700>;
    };

    slow {
        layers = <8>;
        input-processors = <&zip_xy_transform (INPUT_TRANSFORM_X_INVERT | INPUT_TRANSFORM_Y_INVERT)>,
                           <&zip_xy_scaler 4 10>,
                           <&zip_temp_layer 5 700>;
    };
};